## prj.conf
```kconfig
#=========== GUI config ===========
CONFIG_SURFACE_ZERO_BUFFER=y
CONFIG_UI_MEMORY_MANAGER=y
CONFIG_UI_MEMORY_DEBUG=n
CONFIG_MEM_GUARD=n

#actions RES manager
CONFIG_RES_MANAGER=y
CONFIG_RES_MANAGER_USE_STYLE_MMAP=y
CONFIG_RES_MANAGER_SKIP_PRELOAD=n

#actions freetype font
CONFIG_FREETYPE_FONT=y

#actions Bitmap font
CONFIG_BITMAP_FONT=y
CONFIG_BITMAP_FONT_SUPPORT_EMOJI=y
CONFIG_EMOJI_FONT_USE_MMAP=y

#lvgl config
CONFIG_LVGL=y
CONFIG_LVGL_USE_BITMAP_FONT=y
CONFIG_LVGL_USE_FREETYPE_FONT=y
CONFIG_LVGL_USE_RES_MANAGER=y
CONFIG_LV_VDB_NUM=2
CONFIG_LV_CONF_MINIMAL=y
CONFIG_LV_COLOR_DEPTH_16=y
CONFIG_LV_USE_PRIVATE_API=n
CONFIG_LV_BIN_DECODER_RAM_LOAD=y
CONFIG_LV_USE_ETC2=y
CONFIG_LV_USE_IMGFONT=y
CONFIG_LV_USE_SNAPSHOT=y
CONFIG_LV_FONT_DEFAULT_MONTSERRAT_48=n
CONFIG_LV_TXT_ENC_UTF8=y
CONFIG_LV_TXT_BREAK_CHARS=""
CONFIG_LV_USE_LOG=y
CONFIG_LV_USE_ASSERT_NULL=y
CONFIG_LV_USE_ASSERT_MALLOC=y
CONFIG_LV_USE_STRACE=y
CONFIG_LV_USE_STRACE_OBJ_DRAW=n
CONFIG_LV_USE_STRACE_TASK_DRAW=n
CONFIG_LV_USE_FLEX=y
CONFIG_LV_USE_GRID=y
CONFIG_LV_USE_ARC=y
CONFIG_LV_USE_BUTTON=y
CONFIG_LV_USE_BARCODE=y
CONFIG_LV_USE_CANVAS=y
CONFIG_LV_USE_CHART=y
CONFIG_LV_USE_IMAGE=y
CONFIG_LV_USE_IMAGEBUTTON=y
CONFIG_LV_USE_LABEL=y
CONFIG_LV_USE_SLIDER=y
CONFIG_LV_USE_TILEVIEW=y
CONFIG_LV_USE_QRCODE=y
CONFIG_LV_USE_QRCODE=y
CONFIG_LV_FONT_DEFAULT_MONTSERRAT_14=y
CONFIG_LV_FONT_MONTSERRAT_14=y
CONFIG_LV_FONT_MONTSERRAT_24=y
CONFIG_LV_USE_DEMO_WIDGETS=y
CONFIG_LV_USE_DEMO_BENCHMARK=y
CONFIG_LV_USE_TABLE=y
CONFIG_LV_USE_CALENDAR=y
CONFIG_LV_USE_SCALE=y
CONFIG_LV_USE_BUTTONMATRIX=y
CONFIG_LV_USE_TABVIEW=y
CONFIG_LV_USE_CHECKBOX=y
CONFIG_LV_USE_KEYBOARD=y
CONFIG_LV_USE_TEXTAREA=y
CONFIG_LV_USE_SWITCH=y
CONFIG_LV_USE_DROPDOWN=y
CONFIG_LV_USE_CALENDAR_HEADER_DROPDOWN=y
CONFIG_LV_USE_SYSMON=y
CONFIG_LV_USE_PERF_MONITOR=y
CONFIG_LV_PERF_MONITOR_ALIGN_BOTTOM_MID=y
CONFIG_LV_VDB_NUM=2
CONFIG_LV_VDB_SIZE=262144

#=========== system base config ===========
CONFIG_ACTIONS_FRAMEWORK=y
CONFIG_ACTIONS_FRAMEWORK_DISPLAY=y
CONFIG_THREAD_TIMER=y
CONFIG_ACTIONS_UTILS=y
CONFIG_CORE=y
CONFIG_SYSTEM=y
CONFIG_SYS_CLOCK_TICKS_PER_SEC=1000
CONFIG_PRINTK_TIME_FREFIX=n
CONFIG_DMA_PRINTK_BUF_SIZE=4096
CONFIG_SLEEP_SENSOR_RUN_ON_NOR=y
CONFIG_SLEEP_COPY_SRAM_FOR_SENSOR=n
CONFIG_SLEEP_MEMORY_CHECK_INTEGRITY=n
CONFIG_THREAD_RUNTIME_STATS=y
CONFIG_SYSTEM_SHELL=y
CONFIG_TASK_WDT=y
CONFIG_TASK_WDT_TIMEOUT=5000

#power config
CONFIG_POWER=y

#input config
CONFIG_INPUT=y
CONFIG_INPUT_POINTER=y
CONFIG_INPUT_KEYPAD=y
CONFIG_ACTS_RING_BUFFER=y

#standby config
CONFIG_SYS_STANDBY=n
CONFIG_AUTO_STANDBY_TIME_SEC=10
CONFIG_SYS_WAKELOCK=y

#system message config
CONFIG_NUM_MBOX_ASYNC_MSGS=35
CONFIG_MESSAGE_DEBUG=n

#property config
CONFIG_PROPERTY=y
CONFIG_PROPERTY_CACHE=y

#watchdog config
CONFIG_WATCHDOG=n
CONFIG_WDOG_ACTS=n
CONFIG_WDT_MODE_RESET=n

#dvfs config
CONFIG_DVFS=y
CONFIG_ACTS_DVFS_DYNAMIC_LEVEL=y

#memory config
CONFIG_MEMORY=y
CONFIG_SYS_MEMORY_DEBUG=n
CONFIG_APP_USED_MEM_POOL=y
CONFIG_RAM_POOL_PAGE_NUM=9
CONFIG_HEAP_MEM_POOL_SIZE=2560

#system stack config
CONFIG_MAIN_STACK_SIZE=32768
CONFIG_IDLE_STACK_SIZE=4096
CONFIG_SYSTEM_WORKQUEUE_STACK_SIZE=8192

# sdfs config
CONFIG_SD_FS=y
CONFIG_SDFS_MANAGER=y
CONFIG_MUTIPLE_VOLUME_MANAGER=y
CONFIG_SD_FILE_MAX=24
CONFIG_DISKIO_CACHE=n

#=========== display config ===========
CONFIG_DISPLAY=y
CONFIG_DISPLAY_LOG_LEVEL_INF=y
CONFIG_DISPLAY_CONTROLLER=y
CONFIG_DISPLAY_ENGINE=y
CONFIG_DISPLAY_ENGINE_INSTANCE_NUM=4
CONFIG_DMA2D_HAL=y
CONFIG_DMA2D_LITE=y
CONFIG_DISPLAY_WORK_Q=y
CONFIG_DISPLAY_WORK_Q_STACK_SIZE=1536

#=========== libc config ===========
CONFIG_NEWLIB_LIBC=y
CONFIG_NEWLIB_LIBC_FLOAT_PRINTF=y
CONFIG_NEWLIB_LIBC_NANO=y
CONFIG_COMPILER_OPT="-Wno-attributes -Wno-array-bounds -Wno-uninitialized -Wno-unused-function -Wno-implicit-function-declaration -Wno-int-conversion"

CONFIG_DISPLAY_COMPOSER=y
CONFIG_SURFACE_DOUBLE_BUFFER=y
CONFIG_UI_MEM_NUMBER_BLOCKS=2
CONFIG_UI_MEM_BLOCK_SIZE=434312
```

## src/main.c
```c
/*
 * Copyright (c) 2020 Actions Technology Co., Ltd
 *
 * SPDX-License-Identifier: Apache-2.0
 */

/*********************
 *      INCLUDES
 *********************/

#include <stdio.h>
#include <string.h>
#include <stdint.h>
#include <board_cfg.h>
#include <os_common_api.h>
#include <lvgl/lvgl.h>
#include <lvgl/lvgl_ext.h>
#include <lvgl/lvgl_bitmap_font.h>
#include <lvgl/lvgl_freetype_font.h>
#include <lvgl/demos/benchmark/lv_demo_benchmark.h>
#include <drivers/input/input_dev.h>
#include <mem_manager.h>
#include <sys_manager.h>
#include <thread_timer.h>
#include <sys_wakelock.h>
#ifdef CONFIG_DVFS
#include <dvfs.h>
#endif
#include "app_msg.h"

/**********************
 *  STATIC PROTOTYPES
 **********************/

static void _disp_vsync_cb(const lvx_display_observer_t * observer, uint32_t timestamp);
static void _disp_state_cb(const lvx_display_observer_t * observer, uint32_t state);

/**********************
 *  STATIC VARIABLES
 **********************/

static const lvx_display_observer_t g_disp_observer = {
	.vsync_cb = _disp_vsync_cb,
	.state_cb = _disp_state_cb,
};

static uint8_t g_disp_active = 1;

static K_SEM_DEFINE(g_disp_vsync_sem, 0, 1);

/**********************
 *   STATIC FUNCTIONS
 **********************/

static void _disp_vsync_cb(const lvx_display_observer_t *observer, uint32_t timestamp)
{
	k_sem_give(&g_disp_vsync_sem);
}

static void _disp_state_cb(const lvx_display_observer_t *observer, uint32_t state)
{
	switch (state) {
	case LVX_DISPLAY_STATE_OFF:
		app_msg_send(APP_NAME, MSG_UI, CMD_SCREEN_OFF);
		break;
	case LVX_DISPLAY_STATE_ON:
		app_msg_send(APP_NAME, MSG_UI, CMD_SCREEN_ON);
		break;
	default:
		break;
	}
}

static void _keypad_callback(struct device *dev, struct input_value *val)
{
	static uint32_t last_value = 0;

	SYS_LOG_INF("type: %d, code:%d, value:%d\n",
		val->keypad.type, val->keypad.code, val->keypad.value);

	if (last_value != val->keypad.value) {
		// screen on
		sys_wake_lock(FULL_WAKE_LOCK);
		sys_wake_unlock(FULL_WAKE_LOCK);

		last_value = val->keypad.value;
	}
}

static void _keypad_init(void)
{
	struct device *onoff_dev;

	onoff_dev = (struct device *)device_get_binding(CONFIG_INPUT_DEV_ACTS_ONOFF_KEY_NAME);
	if (!onoff_dev) {
		SYS_LOG_ERR("cannot found key dev %s", CONFIG_INPUT_DEV_ACTS_ONOFF_KEY_NAME);
		return;
	}

	input_dev_enable(onoff_dev);
	input_dev_register_notify(onoff_dev, _keypad_callback);
}

static void _lvgl_init(void)
{
	/* LVGL initialize */
	lvx_port_init();
	lvx_display_add_observer(&g_disp_observer);
	lvx_refr_set_manual(NULL);

	/* Set background color */
	lv_obj_set_style_bg_color(lv_screen_active(), lv_color_black(), 0);
	lv_obj_set_style_bg_opa(lv_screen_active(), LV_OPA_COVER, 0);
}

static void _process_ui_msg(struct app_msg *msg)
{
	switch (msg->cmd) {
	case CMD_SCREEN_OFF:
		g_disp_active = 0;
		break;
	case CMD_SCREEN_ON:
		g_disp_active = 1;
		lv_obj_invalidate(lv_screen_active());
		break;
	default:
		break;
	}
}

/**********************
 *   GLOBAL FUNCTIONS
 **********************/

int main(void)
{
	// init system
	mem_manager_init();
	system_init();

	// init app msg
	app_msg_init();

	// init lvgl
	_lvgl_init();

	// init key device
	_keypad_init();

	system_ready();

	lv_demo_benchmark();

#ifdef CONFIG_ACTS_DVFS_DYNAMIC_LEVEL
	dvfs_unset_level(DVFS_LEVEL_HIGH_PERFORMANCE, "init");
	dvfs_set_level(DVFS_LEVEL_NORMAL, "launcher");
#endif

	while (1) {
		struct app_msg msg;

		os_strace_void(SYS_TRACE_ID_GUI_TASK);
		uint32_t lv_timeout = lv_task_handler();
		os_strace_end_call(SYS_TRACE_ID_GUI_TASK);

		uint32_t tt_timeout = thread_timer_next_timeout();
		uint32_t timeout = MIN(lv_timeout, tt_timeout);

		int rc = poll_msg(&msg, &g_disp_vsync_sem, timeout);
		switch (rc) {
		case OS_POLL_MSG:
			SYS_LOG_INF("msg type=0x%x, cmd=0x%x", msg.type, msg.cmd);
			switch (msg.type) {
				case MSG_UI:
					_process_ui_msg(&msg);
					break;
			}
			if (msg.callback != NULL) {
				msg.callback(&msg, 0, NULL);
			}
			break;

		case OS_POLL_SEM:
			if (g_disp_active) {
				lvx_refr_all();
			}
			break;
		}

		thread_timer_handle_expired();
	}

	return 0;
}
```
